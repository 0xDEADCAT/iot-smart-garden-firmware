## src/Kconfig
```kconfig
menu "Smart Garden Configuration"

    config MQTT_BROKER_URL
        string "MQTT Broker URL"
        default "mqtt://hades"
        help
            URL of the MQTT broker the device will connect to.

    choice
        prompt "Select device type"
        help
            This option selects the device type.
    config DEVICE_SENSOR
        bool "Device - Sensor"
        help
            Device is used for soil moisture sensing.

    config DEVICE_PUMP
        bool "Device - Pump"
        help
            Device is used for pump control.
    endchoice

    config PUMP_RESET_TIMER_PERIOD
        int "Time in ms for pump to turn off"
        default 2000
        depends on DEVICE_PUMP
        help
            Time after which the pump will turn off (ms)

endmenu
```
